## Kconfig
```kconfig
menu "Animation Player Configuration"

    config ANIM_PLAYER_DEFAULT_FPS
        int "Default frame rate"
        range 1 60
        default 30
        help
            Default frame rate for animation player in frames per second.

endmenu

menu "FT label color settings"

    choice LABEL_COLOR_DEPTH
        prompt "Color depth."
        default LABEL_COLOR_DEPTH_16
        help
            Color depth to be used.

        config LABEL_COLOR_DEPTH_16
            bool "16: RGB565"
    endchoice

    config LABEL_COLOR_16_SWAP
        bool "Swap the 2 bytes of RGB565 color."
        depends on LABEL_COLOR_DEPTH_16
        default n
endmenu
```
